## buildroot/platform/Config.in
```kconfig
menu "Product Options"

config BR2_CFG_SYSTEM_NAME
	string "System Name"
	default "linux"

config BR2_CFG_PRODUCT_NAME
	string "Product Name"
	default "euicc"

config BR2_CFG_SOFTWARE_NAME
	string "Software Name"
	default "general"

choice
	prompt "Module Type"
	default BR2_CFG_OPEN_MODULE
	help
	  Set module type (open or standard)

config BR2_CFG_OPEN_MODULE
	bool "BR2_CFG_OPEN_MODULE"
	help
	  Open module. This is the default.

config BR2_CFG_STANDARD_MODULE
	bool "BR2_CFG_STANDARD_MODULE"
	help
	  Standard module.

endchoice

choice
	prompt "Build for Platform"
	default BR2_CFG_PLATFORM_9X07

config BR2_CFG_PLATFORM_X86
	bool "x86"
	help
	  Build for X86 platform.

config BR2_CFG_PLATFORM_9X07
	bool "9x07"
	help
	  Build for 9x07 platform

config BR2_CFG_PLATFORM_ANDROID_ARM32
	bool "android-arm32"
	select BR2_CFG_PLATFORM_ANDROID
	help
	  Build for android (ARM32) platform

config BR2_CFG_PLATFORM_ANDROID_ARM64
	bool "android-arm64"
	select BR2_CFG_PLATFORM_ANDROID
	help
	  Build for android (ARM64) platform

endchoice

config BR2_CFG_PLATFORM_ANDROID
	bool "Android"
	help
	  Build for android platform

choice
	prompt "Software Type"
	default BR2_CFG_SOFTWARE_TYPE_RELEASE
	help
	  Select software type, Release, Debug ...

config BR2_CFG_SOFTWARE_TYPE_RELEASE
	bool "Release"
	help
	  Compile software with Signature/Authentication.
	  This version used for final release.

config BR2_CFG_SOFTWARE_TYPE_DEBUG
	bool "Debug"
	help
	  Compile software debug version.
	  This version used for development stage.

endchoice

choice
	prompt "Environment Type"
	default BR2_CFG_ENV_TYPE_PROD
	help
	  Select environment type, staging, prod ...

config BR2_CFG_ENV_TYPE_PROD
	bool "prod"
	help
	  Running at product environment.

config BR2_CFG_ENV_TYPE_STAG
	bool "staging"
	help
	  Running at staging environment.

config BR2_CFG_ENV_TYPE_QA
	bool "qa"
	help
	  Running at qa environment.

endchoice

choice
	prompt "Mqtt Type"
	default BR2_CFG_DOWN_EMQ_MQTT_ENABLE
	help
	  Set mqtt type (mqtt or mqtts)

config BR2_CFG_DOWN_EMQ_MQTT_ENABLE
	bool "BR2_CFG_DOWN_EMQ_MQTT_ENABLE"
	help
	  mqtt type. This is the default.

config BR2_CFG_DOWN_EMQ_MQTTS_ENABLE
	bool "BR2_CFG_DOWN_EMQ_MQTTS_ENABLE"
	help
	  mqtts type.

endchoice

choice
	prompt "Http Type"
	default BR2_CFG_UPLOAD_HTTP_ENABLE
	help
	  Set http type (http or https)

config BR2_CFG_UPLOAD_HTTP_ENABLE
	bool "BR2_CFG_UPLOAD_HTTP_ENABLE"
	help
	  http type. This is the default.

config BR2_CFG_UPLOAD_HTTPS_ENABLE
	bool "BR2_CFG_UPLOAD_HTTPS_ENABLE"
	help
	  https type.

endchoice

config BR2_CFG_MODULE_TYPE
	string
	default "open"        		if BR2_CFG_OPEN_MODULE
	default "standard"     		if BR2_CFG_STANDARD_MODULE

config BR2_CFG_PLATFORM_TYPE
	string
	default "x86"               if BR2_CFG_PLATFORM_X86
	default "9x07"              if BR2_CFG_PLATFORM_9X07
	default "android-arm32"     if BR2_CFG_PLATFORM_ANDROID_ARM32
	default "android-arm64"     if BR2_CFG_PLATFORM_ANDROID_ARM64

config BR2_CFG_HTTP_TYPE
	string
	default "https"		    	if BR2_CFG_UPLOAD_HTTPS_ENABLE
	default "http"	        	if BR2_CFG_UPLOAD_HTTP_ENABLE

config BR2_CFG_MQTT_TYPE
	string
	default "mqtts"		    	if BR2_CFG_DOWN_EMQ_MQTTS_ENABLE
	default "mqtt"	        	if BR2_CFG_DOWN_EMQ_MQTT_ENABLE

config BR2_CFG_SOFTWARE_TYPE
	string
	default "debug"				if BR2_CFG_SOFTWARE_TYPE_DEBUG
	default "release"			if BR2_CFG_SOFTWARE_TYPE_RELEASE

config BR2_CFG_ENV_TYPE
	string
	default "prod"	        	if BR2_CFG_ENV_TYPE_PROD
	default "stag"				if BR2_CFG_ENV_TYPE_STAG
	default "qa" 				if BR2_CFG_ENV_TYPE_QA

config BR2_OUTPUT_PATH
	string "Output Path"
	default "$(BR2_CFG_SOFTWARE_NAME)-$(BR2_CFG_PLATFORM_TYPE)-$(BR2_CFG_SOFTWARE_TYPE)"

config BR2_IMAGE_NAME
	string "Image Name"
	default "$(BR2_CFG_SOFTWARE_NAME)-$(BR2_CFG_PLATFORM_TYPE)-$(BR2_CFG_SOFTWARE_TYPE)"

endmenu
```

## buildroot/release/Config.in
```kconfig
menu "Release"

config BR2_PACKAGE_RELEASE_BUILD
	bool "Packet Release Targets"
	default y
	help
		Packet all release targets.
	  	
if BR2_PACKAGE_RELEASE_BUILD

config BR2_RELEASE_INSTALL_PATH
	string "Release Targets Install Path"
	default "$(BASE_DIR)/system/release"
	help 
		Released targets install path configuration

config BR2_RELEASE_VERSION
	string "Release Targets Version"
	default "v1.0.0.0"
	help 
		Released targets version configuration
		
config BR2_RELEASE_TARGET
	string "Release Targets Name"
	default ""
	help 
		Released targets name configuration
		
endif

endmenu
```

## buildroot/sdk/Config.in
```kconfig
menu "SDK"

config BR2_PACKAGE_SDK_BUILD
	bool "Build SDK"
	default y
	help
		Build SDK for application developers.
	  	
if BR2_PACKAGE_SDK_BUILD

config BR2_SDK_INSTALL_PATH
	string "sdk install path"
	default "$(BASE_DIR)/system/sdk"
	help 
		SDK install path configuration

endif

endmenu
```

## buildroot/sysapp/Config.in
```kconfig
menu "System Application"

comment "System Application"

config BR2_PACKAGE_SYSAPP
	bool "Build System Application"
	default y
	help
	  Enable this option if you want to build system application for your embedded device

if BR2_PACKAGE_SYSAPP

config BR2_SYSAPP_SOURCE_PATH
	string
	default "$(WORKSPACE)/sysapp"

config BR2_SYSAPP_INSTALL_PATH
	string "System Application Install Path"
	default "$(BASE_DIR)/system/bin"

source ".config_wrapper/sysapp_wrapper.in"

if BR2_CONFIG_SYSAPP_AGENT

menu "Agent Config Options"

config BR2_CFG_AGENT_OTA_ON
	bool "BR2_CFG_AGENT_OTA_ON"
	help
	  Enable this option if you want to get OTA upgrade feature in agent.
	  
config BR2_CFG_AGENT_BOOTSRRAP_ON
	bool "BR2_CFG_AGENT_BOOTSRRAP_ON"
	help
	  Enable this option if you want to get getbootstrap feature in agent.

config BR2_CFG_AGENT_PERSONALISE_ON
	bool "BR2_CFG_AGENT_PERSONALISE_ON"
	help
	  Enable this option if you want to get personalise feature in agent.

config BR2_CFG_LPA_LOG_ON	  
	bool "BR2_CFG_LPA_LOG_ON"
	help
	  Enable this option if you want to open lpa logger.

config BR2_CFG_TEST_LPA_ON	  
	bool "BR2_CFG_TEST_LPA_ON"
	help
	  Enable this option if you want to export test lpa tool.

config BR2_CFG_SHARE_PROFILE_ECC_VERIFY	  
	bool "BR2_CFG_SHARE_PROFILE_ECC_VERIFY"
	help
	  Enable this option if share profile signature of SHA256withECC.

config BR2_CFG_AGENT_SINGLE_BOOTSRRAP_ON	  
	bool "BR2_CFG_AGENT_SINGLE_BOOTSRRAP_ON"
	help
	  Enable this option if you need to output libbootstrap.so.

config BR2_CFG_REDTEA_READY_ON
	bool "BR2_CFG_REDTEA_READY_ON"
	help
	  Enable this option if you need to bulid RedteaReady.

config BR2_CFG_SIM_DETECT_ON
	bool "BR2_CFG_SIM_DETECT_ON"
	help
	  Enable this option if you need to detect SIM.

config BR2_CFG_TEST_CLIENT_ON	  
	bool "BR2_CFG_TEST_CLIENT_ON"
	help
	  Enable this option if you want to export test lpa tool.

endmenu

endif

endif

endmenu
```

## buildroot/toolchain/Config.in
```kconfig
menu "Toolchain"

config BR2_TOOLCHAIN_INSTALL_PATH
	string "Toolchain Install Path"
	default "$(WORKSPACE)/toolchain/"
	help
		local path of the custom toolchain tarball to install.

config BR2_TOOLCHAIN_PREFIX
	string "Toolchain Prefix for Cross Compile"
	default "ndk/toolchains/mcore-elf-ccore/prebuilt/linux-x86/bin/mcore-elf-"
	help
	  Enable this option if you want to build sp.

config BR2_TOOLCHAIN_SYSROOT
	string "Sysroot Config"
	default "ndk/toolchains/mcore-elf-ccore/prebuilt/linux-x86/bin/mcore-elf-"
	help
	  Enable this option if you want to build with --sysroot=xxx.

config BR2_TOOLCHAIN_SYSINC
	string "Sysinc Config"
	default "ndk/toolchains/mcore-elf-ccore/prebuilt/linux-x86/bin/mcore-elf-"
	help
	  Enable this option if you want to build with --sysinc=xxx.
	  
endmenu
```
